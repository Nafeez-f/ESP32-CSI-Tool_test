## passive/main/Kconfig.projbuild
```kconfig
menu "ESP32 CSI Tool Config"

    config WIFI_CHANNEL
        int "WiFi Channel"
        default 6
        help
            Select the WiFi channel to listen to passively. In North America, valid channels are {1,2,3,...,10,11}.

    config SHOULD_COLLECT_CSI
        bool "Should this ESP32 collect and print CSI data?"
        default "y"
        help
            Allowing only a single ESP32 to collect CSI will likely increase the sampling frequency of your experiments.

    config SHOULD_COLLECT_ONLY_LLTF
        depends on SHOULD_COLLECT_CSI
        bool "(Advanced users only) Should we only collect LLTF?"
        default "y"
        help
            Each CSI frame can contain CSI either calculated through
            (1) legacy long training field (LLTF),
            (2) high throughput LTF (HT-LTF) and/or
            (3) space-time block code HT-LTF (STBC-HT-LTF).
            However, not all CSI frames have HT-LTF or STBC-HT-LTF while all CSI frame have LLTF.
            For beginners collecting only LLTF is the best option while advanced users can handle issues such as
            (1) HT-LTF or STBC-HT-LTF being missing, and
            (2) possible decreases in sampling rate due to serial connection saturation.
            [Advanced Users]: I cannot always help with these advanced issues,
            but if you have ideas on improvements to these issues please share!

    config SEND_CSI_TO_SERIAL
        depends on SHOULD_COLLECT_CSI
        bool "Send CSI data to Serial"
        default "y"
        help
            Sending data through serial (to a computer) can take time and buffer space.
            If you are storing to an SD card, it may be useful to deselect this option.

    config SEND_CSI_TO_SD
        depends on SHOULD_COLLECT_CSI
        bool "Send CSI data to SD"
        default "n"
        help
            Sending data to an SD card can take time and buffer space.
            If your ESP32 does not have an SD card, there is no reason to use this feature.
            If you do though, the program will be recognize this and not attempt writing to the SD card.

    config ISAC_AUTO_SCAN
        bool "Auto-test bandwidth (HT20/HT40) at boot"
        default "y"
        help
            On startup, test HT20/HT40-above/HT40-below on the configured WiFi
            Channel and pick the mode with the most frames. Does NOT change the
            channel — only the bandwidth mode.
            This is needed because routers use either HT40-above or HT40-below
            and picking the wrong one means missing all HT data frames.
            After the test, prints a LISTMACS table.
            Disable this if you already know the correct bandwidth mode.

    config ISAC_AUTO_SCAN_DWELL_MS
        depends on ISAC_AUTO_SCAN
        int "Dwell time per mode during auto-scan (ms)"
        default 500
        help
            How long to listen on each channel+bandwidth combination during
            the boot scan. Lower = faster boot but less accurate. 500ms is
            a good balance.

    menu "ISAC MAC Filter (optional)"
        depends on SHOULD_COLLECT_CSI
        comment "Leave blank to collect CSI from every sender on the channel."
        comment "Fill in the MAC(s) of the devices whose communication you want to sense"
        comment "(e.g. your PC and your router). Format: AA:BB:CC:DD:EE:FF"
        comment "You can also add/remove MACs at runtime via the WATCHMAC / CLEARMAC serial commands."

        config ISAC_WATCH_MAC_1
            string "Watched MAC address #1 (e.g. your PC)"
            default ""
            help
                First MAC address to watch. CSI will only be recorded from senders in this list.
                Leave empty to disable compile-time filtering (filtering can still be enabled at runtime).

        config ISAC_WATCH_MAC_2
            string "Watched MAC address #2 (e.g. your router/AP)"
            default ""
            help
                Second MAC address to watch.

        config ISAC_WATCH_MAC_3
            string "Watched MAC address #3"
            default ""
            help
                Third MAC address to watch.

        config ISAC_WATCH_MAC_4
            string "Watched MAC address #4"
            default ""
            help
                Fourth MAC address to watch.
    endmenu
endmenu
```

## passive_csi/main/Kconfig.projbuild
```kconfig
menu "Passive CSI Config"

    config CSI_CHANNEL
        int "WiFi Channel to listen on"
        default 6
        help
            The 2.4 GHz channel your AP/hotspot is using.
            Run 'airport -I | grep channel' on macOS to find it.
            Valid range: 1-13.

    config CSI_CHANNEL_BW
        int "Channel bandwidth: 0=HT20 (20MHz)  1=HT40-above  2=HT40-below"
        default 1
        help
            Modern APs and phone hotspots almost always use HT40 (40MHz).
            HT40-above means the secondary channel is above the primary
            (e.g. primary=6, secondary=10).
            HT40-below means the secondary channel is below
            (e.g. primary=6, secondary=2).
            If you see zero data frames from your AP, try the other value.
            Default 1 (HT40-above) works for most iPhone hotspots on ch6.

    config CSI_LLTF_ONLY
        bool "Collect LLTF only (smaller CSI, higher throughput)"
        default y
        help
            LLTF (Legacy Long Training Field) is present in every frame.
            Enabling this limits CSI to 128 bytes (64 subcarriers) per frame
            and keeps the serial port from saturating.
            Disable only if you need HT-LTF data and have a fast baud rate.

endmenu
```
